/*
 * Top level DTS file for CVM:P3668-0001 and AD-GMSL522-SL.
 *
 * Copyright (c) 2023, Analog Devices Inc. All rights reserved.
 *
 * This program is free software; you can redistribute it and/or modify
 * it under the terms of the GNU General Public License as published by
 * the Free Software Foundation; version 2 of the License.
 *
 * This program is distributed in the hope that it will be useful, but WITHOUT
 * ANY WARRANTY; without even the implied warranty of MERCHANTABILITY or
 * FITNESS FOR A PARTICULAR PURPOSE.  See the GNU General Public License for
 * more details.
 */

/dts-v1/;
#include "common/tegra194-p3668-common.dtsi"
#include "common/tegra194-gmsl522-reva.dtsi"

/ {
	nvidia,dtsfilename = __FILE__;
	nvidia,dtbbuildtime = __DATE__, __TIME__;

	compatible = "adi,gmsl522+p3668-0001", "nvidia,tegra194";
	model = "Analog Devices AD-GMSL522-SL Kit RevB";

	sdhci@3440000 {
		status = "okay";
		cd-gpios = <&tegra_main_gpio TEGRA194_MAIN_GPIO(L, 0) GPIO_ACTIVE_HIGH>;
		nvidia,cd-wakeup-capable;
		disable-wp;
		no-sdio;
		no-mmc;
		vmmc-supply = <&p3668_vdd_sdmmc1_sw>;
	};
};

&tca9548 {
	reset-gpios = <&tegra_main_gpio TEGRA194_MAIN_GPIO(L, 1) GPIO_ACTIVE_LOW>;
};
