// SPDX-License-Identifier: GPL-2.0
/*
 * Copyright (C) 2023 Analog Devices Inc.
 */

/dts-v1/;

#include "tegra194-p3668-0001-gmsl522-reva.dts"

&GMSL_DES_I2C_LABEL {
	clock-frequency = <400000>;
};

#include "../../../../../../kernel/kernel-5.10/arch/arm64/boot/dts/gmsl/gmsl.dtsi"
